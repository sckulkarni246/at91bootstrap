## configs/sama5d27_jupiter_nanosd1_uboot_defconfig
```kconfig
CONFIG_DEBUG=y
CONFIG_DEBUG_VERY_LOUD=y
CONFIG_DDR_SET_BY_DEVICE=y
CONFIG_DDR_AD210032F=y
CONFIG_SDCARD=y
CONFIG_SDHC1=y
CONFIG_JUMP_ADDR="0x23f00000"
CONFIG_LED_ON_BOARD=y
CONFIG_LED_B_ON_PIOA=y
CONFIG_LED_B_PIN=6
CONFIG_LED_B_VALUE=1
```
